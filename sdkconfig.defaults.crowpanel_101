## sdkconfig.defaults.crowpanel_101
```kconfig
# Board: CrowPanel Advanced 10.1" ESP32-P4 (1024x600 MIPI DSI)
CONFIG_KERN_BOARD_CROWPANEL_101=y
CONFIG_ESPTOOLPY_FLASHMODE_QIO=y
# 3 hardware frame buffers required for MIPI DSI TRIPLE_PARTIAL mode (portrait rotation)
CONFIG_BSP_LCD_DPI_BUFFER_NUMS=3
```

## sdkconfig.defaults.wave_p4_pico
```kconfig
# Board: Waveshare ESP32-P4-Pico + ST7789 320x240 SPI display + GT911 touch
CONFIG_KERN_BOARD_WAVE_P4_PICO=y
CONFIG_ESPTOOLPY_FLASHMODE_QIO=y
CONFIG_SPIRAM_MODE_HEX=y
CONFIG_SPIRAM_XIP_FROM_PSRAM=n
```
